/dts-v1/;
/plugin/;

/ {
    compatible = "brcm,bcm2835";

    fragment@0 {
        target = <&i2c1>;
        __overlay__ {
            status = "okay";
            lcd1602: lcd1602@27 {
                compatible = "a0,pcf8574";
                reg = <0x27>;
            };
        };
    };
};
